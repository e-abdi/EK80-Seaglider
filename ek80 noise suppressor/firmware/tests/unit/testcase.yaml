## ek80 noise suppressor/firmware/tests/unit/testcase.yaml
```yaml
common:
  platform_allow:
    - native_sim/native/64
  integration_platforms:
    - native_sim/native/64
tests:
  ek80.unit.protocol: {}
```
