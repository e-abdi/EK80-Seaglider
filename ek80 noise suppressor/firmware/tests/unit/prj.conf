## CMakeLists.txt
```
# Unit and scenario tests on the host (native_sim):
#
#   west build -b native_sim/native/64 firmware/tests/unit
#   build/zephyr/zephyr.exe
#
cmake_minimum_required(VERSION 3.20.0)

set(EK80_ROOT ${CMAKE_CURRENT_LIST_DIR}/../..)
set(KCONFIG_ROOT ${EK80_ROOT}/Kconfig)

find_package(Zephyr REQUIRED HINTS $ENV{ZEPHYR_BASE})
project(ek80_unit)

include(${EK80_ROOT}/ek80.cmake)
target_sources(app PRIVATE
  src/fake_hw.c
  src/test_protocol.c
)
```

## prj.conf
```kconfig
CONFIG_ZTEST=y
CONFIG_SMF=y
CONFIG_SMF_ANCESTOR_SUPPORT=y
CONFIG_SMF_INITIAL_TRANSITION=y
CONFIG_LOG=y
CONFIG_LOG_MODE_IMMEDIATE=y
CONFIG_EK80_LOG_LEVEL_WRN=y
# Tests drive time explicitly; the watchdog is a board concern
CONFIG_EK80_WATCHDOG_TIMEOUT_MS=0
```

## src/fake_hw.c
```c
#include "fake_hw.h"

#include <string.h>
#include <zephyr/sys/util.h>

#include "core/app.h"

#define TX_CAP     8192
#define MAX_EVENTS 64

static char tx[PORT_NUM][TX_CAP];
static size_t tx_len[PORT_NUM];
static struct port_stats stats[PORT_NUM];
static struct coil_event events[MAX_EVENTS];
static int n_events;
static bool coil_on[2];
static bool overlapped;
static int vbat_cv;
int64_t t_now;

void fake_reset(void)
{
	fake_tx_clear();
	memset(stats, 0, sizeof(stats));
	n_events = 0;
	coil_on[0] = coil_on[1] = false;
	overlapped = false;
	vbat_cv = 1200;
	t_now = 0;
}

int port_init(void)
{
	return 0;
}

void port_wait_ms(int32_t ms)
{
	ARG_UNUSED(ms);
}

void port_write(enum ek80_port port, const char *data, size_t len)
{
	size_t room = TX_CAP - 1 - tx_len[port];
	size_t n = len < room ? len : room;

	memcpy(&tx[port][tx_len[port]], data, n);
	tx_len[port] += n;
	tx[port][tx_len[port]] = '\0';
}

size_t port_read(enum ek80_port port, uint8_t *buf, size_t cap)
{
	ARG_UNUSED(port);
	ARG_UNUSED(buf);
	ARG_UNUSED(cap);
	return 0;
}

void port_discard_rx(enum ek80_port port)
{
	ARG_UNUSED(port);
}

const struct port_stats *port_get_stats(enum ek80_port port)
{
	return &stats[port];
}

int board_io_init(void)
{
	return 0;
}

void relay_coil_set(enum relay_coil coil, bool energized)
{
	if (energized && coil_on[!coil]) {
		overlapped = true;
	}
	coil_on[coil] = energized;
	if (n_events < MAX_EVENTS) {
		events[n_events++] = (struct coil_event){.coil = coil, .on = energized, .t = t_now};
	}
}

int vbat_read_cv(void)
{
	return vbat_cv;
}

void board_watchdog_feed(void)
{
}

const char *fake_tx(enum ek80_port port)
{
	return tx[port];
}

void fake_tx_clear(void)
{
	memset(tx_len, 0, sizeof(tx_len));
	tx[PORT_GLIDER][0] = tx[PORT_EK80][0] = '\0';
}

int fake_count(enum ek80_port port, const char *needle)
{
	int n = 0;
	size_t len = strlen(needle);

	for (const char *p = tx[port]; (p = strstr(p, needle)) != NULL; p += len) {
		n++;
	}
	return n;
}

void fake_set_vbat_cv(int cv)
{
	vbat_cv = cv;
}

int fake_coil_events(const struct coil_event **ev)
{
	*ev = events;
	return n_events;
}

bool fake_coil_on(enum relay_coil coil)
{
	return coil_on[coil];
}

bool fake_coils_overlapped(void)
{
	return overlapped;
}

void glider_says(const char *text)
{
	app_feed(PORT_GLIDER, (const uint8_t *)text, strlen(text), t_now);
}

void ek80_says(const char *text)
{
	app_feed(PORT_EK80, (const uint8_t *)text, strlen(text), t_now);
}

void advance_ms(int ms)
{
	for (int i = 0; i < ms; i += 10) {
		t_now += 10;
		app_poll(t_now);
	}
}
```

## src/fake_hw.h
```c
/* Test doubles for the serial ports and board I/O, plus scenario helpers. */
#pragma once

#include <stdbool.h>
#include <stdint.h>

#include "core/board_io.h"
#include "core/port.h"

extern int64_t t_now;

struct coil_event {
	enum relay_coil coil;
	bool on;
	int64_t t;
};

void fake_reset(void);
const char *fake_tx(enum ek80_port port);
void fake_tx_clear(void);
int fake_count(enum ek80_port port, const char *needle);
void fake_set_vbat_cv(int cv);

/* Relay coil history and current drive */
int fake_coil_events(const struct coil_event **events);
bool fake_coil_on(enum relay_coil coil);
bool fake_coils_overlapped(void);

/* Scenario helpers: send text into a port, advance time in 10 ms steps */
void glider_says(const char *text);
void ek80_says(const char *text);
void advance_ms(int ms);
```

## src/test_protocol.c
```c
/*
 * End-to-end scenarios: glider commands and EK80 prompts in, relay pulses
 * and serial output checked against the glider/EK80 protocol.
 */
#include <string.h>
#include <zephyr/ztest.h>

#include "core/app.h"
#include "core/controller.h"
#include "fake_hw.h"

#define PULSE CONFIG_EK80_RELAY_PULSE_MS
#define WAKE  CONFIG_EK80_WAKE_DELAY_MS

static void before(void *f)
{
	ARG_UNUSED(f);
	fake_reset();
	app_init(0);
	/* Boot pulse on the off coil */
	advance_ms(PULSE);
	fake_tx_clear();
}

ZTEST_SUITE(ek80, NULL, NULL, before, NULL, NULL);

/* Drive a dive up to the running ensemble */
static void start_ensemble(void)
{
	glider_says("1SRTC 20261017120000\r\n");
	advance_ms(PULSE);
	ek80_says("CMD:\r\n");
	ek80_says("CMD:\r\n");
	ek80_says("HANDSHAKE\r\n");
	advance_ms(WAKE);
	ek80_says("CMD:\r\n");
	zassert_equal(controller_state(), ST_RUNNING);
}

ZTEST(ek80, test_boot_switches_relay_to_charger)
{
	const struct coil_event *ev;

	fake_reset();
	app_init(0);
	zassert_equal(controller_state(), ST_RESET);
	zassert_true(fake_coil_on(RELAY_COIL_EK80_OFF));
	advance_ms(PULSE);
	zassert_equal(controller_state(), ST_OFF);
	zassert_equal(fake_coil_events(&ev), 2);
	zassert_equal(ev[0].coil, RELAY_COIL_EK80_OFF);
	zassert_true(ev[0].on);
	zassert_equal(ev[1].t, PULSE);
	zassert_false(ev[1].on);
	zassert_equal(strlen(fake_tx(PORT_GLIDER)), 0, "boot is silent");
}

ZTEST(ek80, test_full_dive)
{
	const struct coil_event *ev;
	int n0 = fake_coil_events(&ev);

	fake_set_vbat_cv(1234);
	glider_says("1SRTC 20261017120000\r\n");
	zassert_equal(controller_state(), ST_POWER_ON);
	zassert_true(fake_coil_on(RELAY_COIL_EK80_ON));
	zassert_equal(strlen(fake_tx(PORT_GLIDER)), 0, "dive start gets no reply");

	advance_ms(PULSE - 10);
	zassert_true(fake_coil_on(RELAY_COIL_EK80_ON));
	advance_ms(10);
	zassert_false(fake_coil_on(RELAY_COIL_EK80_ON));
	zassert_equal(controller_state(), ST_SEND_TIME);
	zassert_equal(controller_status()->start_cv, 1234);

	ek80_says("CMD:\r\n");
	zassert_equal(strcmp(fake_tx(PORT_EK80), "SRTC 20261017120000\r\n"), 0);
	ek80_says("CMD:\r\n");
	zassert_equal(controller_state(), ST_WAIT_SLEEP);
	ek80_says("HANDSHAKE\r\n");
	advance_ms(WAKE - 10);
	zassert_equal(fake_count(PORT_EK80, "wake\n"), 0, "wake too early");
	advance_ms(10);
	zassert_equal(fake_count(PORT_EK80, "wake\n"), 1);
	ek80_says("CMD:\r\n");
	zassert_equal(controller_state(), ST_RUNNING);
	zassert_false(controller_status()->ping_ok);

	ek80_says("120001 PING_OK 1\r\n");
	zassert_true(controller_status()->ping_ok);

	fake_set_vbat_cv(1180);
	glider_says("1STOP\r\n");
	zassert_equal(controller_state(), ST_RUNNING, "waits for the EK80 to stop");
	ek80_says("CMD:\r\n");
	ek80_says("HANDSHAKE\r\n");
	zassert_equal(controller_state(), ST_POWER_OFF);
	zassert_true(fake_coil_on(RELAY_COIL_EK80_OFF));
	zassert_equal(strlen(fake_tx(PORT_GLIDER)), 0, "no prompt before the relay is off");

	advance_ms(PULSE);
	zassert_equal(controller_state(), ST_OFF);
	zassert_false(fake_coil_on(RELAY_COIL_EK80_OFF));
	zassert_equal(strcmp(fake_tx(PORT_GLIDER), "CMD:\r\n"), 0);
	zassert_equal(strcmp(fake_tx(PORT_EK80), "SRTC 20261017120000\r\n"
						 "SLEEP\n"
						 "wake\n"
						 "RUN ENSEMBLE 1\n"
						 "\n"
						 "SLEEP\n"),
		      0, "EK80 got: %s", fake_tx(PORT_EK80));

	fake_tx_clear();
	glider_says("VOLTAGE\r\n");
	zassert_equal(strcmp(fake_tx(PORT_GLIDER), "1,1234,1180\r\nCMD:\r\n"), 0);

	/* on, off, off-pulse on, off-pulse off */
	zassert_equal(fake_coil_events(&ev) - n0, 4);
	zassert_false(fake_coils_overlapped());
}

ZTEST(ek80, test_ensemble_ending_by_itself_powers_off)
{
	start_ensemble();
	ek80_says("CMD:\r\n");
	ek80_says("HANDSHAKE\r\n");
	advance_ms(PULSE);
	zassert_equal(controller_state(), ST_OFF);
	zassert_equal(strcmp(fake_tx(PORT_GLIDER), "CMD:\r\n"), 0);
}

ZTEST(ek80, test_dive_stop_before_running_resets_silently)
{
	glider_says("1SRTC 20261017120000\r\n");
	advance_ms(PULSE);
	zassert_equal(controller_state(), ST_SEND_TIME);

	fake_set_vbat_cv(1111);
	glider_says("1STOP\r\n");
	zassert_equal(controller_state(), ST_RESET);
	zassert_true(fake_coil_on(RELAY_COIL_EK80_OFF));
	advance_ms(PULSE);
	zassert_equal(controller_state(), ST_OFF);
	zassert_equal(strlen(fake_tx(PORT_GLIDER)), 0, "no prompt in the reset case");
	zassert_equal(controller_status()->end_cv, 1111);
}

ZTEST(ek80, test_dive_stop_during_power_off_drops_prompt)
{
	start_ensemble();
	ek80_says("CMD:\r\n");
	ek80_says("HANDSHAKE\r\n");
	zassert_equal(controller_state(), ST_POWER_OFF);
	glider_says("1STOP\r\n");
	advance_ms(PULSE);
	zassert_equal(controller_state(), ST_OFF);
	zassert_equal(strlen(fake_tx(PORT_GLIDER)), 0);
	zassert_false(fake_coils_overlapped());
}

ZTEST(ek80, test_climb_commands)
{
	glider_says("2SRTC 20261017130000\r\n");
	zassert_equal(controller_state(), ST_OFF);
	zassert_equal(strlen(fake_tx(PORT_GLIDER)), 0);
	glider_says("2STOP\r\n");
	zassert_equal(strcmp(fake_tx(PORT_GLIDER), "CMD:\r\n"), 0);
}

ZTEST(ek80, test_stop_must_match_exactly)
{
	glider_says("1STOPX\r\n");
	glider_says("2STOP NOW\r\n");
	zassert_equal(controller_state(), ST_OFF);
	zassert_equal(strlen(fake_tx(PORT_GLIDER)), 0);
}

ZTEST(ek80, test_live_output)
{
	glider_says("live on\r\n");
	zassert_equal(strcmp(fake_tx(PORT_GLIDER), "live output on\r\n"), 0);
	start_ensemble();
	fake_tx_clear();
	ek80_says("  depth 12.5 m  \r\n");
	zassert_equal(strcmp(fake_tx(PORT_GLIDER), "depth 12.5 m\r\n"), 0, "trimmed echo");

	fake_tx_clear();
	glider_says("live off\r\n");
	ek80_says("depth 13 m\r\n");
	zassert_equal(strcmp(fake_tx(PORT_GLIDER), "live output off\r\n"), 0);
}

ZTEST(ek80, test_reset_clears_live_and_ping)
{
	glider_says("live on\r\n");
	start_ensemble();
	ek80_says("xx PING_OK\r\n");
	zassert_true(controller_status()->ping_ok);
	glider_says("r\r\n");
	zassert_equal(controller_state(), ST_RESET);
	zassert_false(controller_status()->live);
	zassert_false(controller_status()->ping_ok);
	advance_ms(PULSE);
	zassert_equal(controller_state(), ST_OFF);
}

ZTEST(ek80, test_ping_ok_needs_a_long_line)
{
	start_ensemble();
	ek80_says("PING_O\r\n");
	ek80_says("PING_OK\r\n"); /* 7 chars: needs length > 6 */
	zassert_true(controller_status()->ping_ok);
}

ZTEST(ek80, test_voltage_query)
{
	fake_set_vbat_cv(1256);
	glider_says("v\r\n");
	zassert_equal(strcmp(fake_tx(PORT_GLIDER), "1256\r\n"), 0);
	fake_tx_clear();
	glider_says("VOLTAGE\r\n");
	zassert_equal(strcmp(fake_tx(PORT_GLIDER), "0,0,0\r\nCMD:\r\n"), 0);
}

ZTEST(ek80, test_prompts_wait_for_the_right_token)
{
	glider_says("1SRTC 1\r\n");
	advance_ms(PULSE);
	ek80_says("HANDSHAKE\r\n");
	zassert_equal(controller_state(), ST_SEND_TIME, "HANDSHAKE is not CMD");
	ek80_says("CMD:\r\n");
	ek80_says("CMD:\r\n");
	ek80_says("CMD:\r\n");
	zassert_equal(controller_state(), ST_WAIT_SLEEP, "extra CMD ignored");
	ek80_says("HANDSHAKE\r\n");
	ek80_says("CMD:\r\n");
	zassert_equal(controller_state(), ST_WAKE_DELAY, "CMD during the wake delay dropped");
	advance_ms(WAKE);
	zassert_equal(controller_state(), ST_SEND_RUN, "needs a fresh CMD");
}

ZTEST(ek80, test_ek80_ignored_when_off_or_powering_up)
{
	ek80_says("CMD:\r\n");
	zassert_equal(strlen(fake_tx(PORT_EK80)), 0);
	glider_says("1SRTC 1\r\n");
	ek80_says("CMD:\r\n");
	advance_ms(PULSE);
	zassert_equal(controller_state(), ST_SEND_TIME);
	zassert_equal(strlen(fake_tx(PORT_EK80)), 0);
}

ZTEST(ek80, test_partial_line_does_not_leak_between_sessions)
{
	start_ensemble();
	ek80_says("CMD:\r\nHANDSHAKE\r\nCM");
	advance_ms(PULSE);
	glider_says("1SRTC 2\r\n");
	advance_ms(PULSE);
	ek80_says("D:\r\n"); /* would read "CMD:" if the stale "CM" survived */
	zassert_equal(controller_state(), ST_SEND_TIME);
}

ZTEST(ek80, test_new_dive_start_restarts_sequence)
{
	start_ensemble();
	glider_says("1SRTC 20261017140000\r\n");
	zassert_equal(controller_state(), ST_POWER_ON);
	zassert_true(fake_coil_on(RELAY_COIL_EK80_ON));
	advance_ms(PULSE);
	fake_tx_clear();
	ek80_says("CMD:\r\n");
	zassert_equal(strcmp(fake_tx(PORT_EK80), "SRTC 20261017140000\r\n"), 0);
	zassert_false(fake_coils_overlapped());
}

ZTEST(ek80, test_commands_are_trimmed_and_cr_terminated)
{
	glider_says("   1SRTC 99  \r");
	advance_ms(PULSE);
	ek80_says("CMD:\n");
	zassert_equal(strcmp(fake_tx(PORT_EK80), "SRTC 99\r\n"), 0);
}

ZTEST(ek80, test_prefix_matching)
{
	fake_set_vbat_cv(1300);
	glider_says("version\r\n"); /* any line starting with 'v' */
	zassert_equal(strcmp(fake_tx(PORT_GLIDER), "1300\r\n"), 0);
	fake_tx_clear();
	glider_says("hello\r\n");
	zassert_equal(strlen(fake_tx(PORT_GLIDER)), 0);
	glider_says("restart\r\n"); /* any line starting with 'r' */
	zassert_equal(controller_state(), ST_RESET);
}
```
